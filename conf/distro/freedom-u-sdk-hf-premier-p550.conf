## conf/distro/freedom-u-sdk-hf-premier-p550.conf
```bitbake
DISTRO = "freedom-u-sdk-hf-premier-p550"
DISTRO_NAME = "FreedomUSDK (SiFive Freedom Unleashed SDK)"
DISTRO_VERSION = "2024.08.00-hf-prem-p550"
DISTRO_CODENAME = "2024.08"
SDK_VENDOR = "-freedomusdk"
SDK_VERSION = "${@d.getVar('DISTRO_VERSION').replace('snapshot-${METADATA_REVISION}', 'snapshot')}"
SDK_VERSION[vardepvalue] = "${SDK_VERSION}"

MAINTAINER = "SiFive <null@sifive.com>"

TARGET_VENDOR = "-freedomusdk"

LOCALCONF_VERSION = "2"

# Override these in FreedomUSDK based distros
FREEDOM_DEFAULT_DISTRO_FEATURES = "bluetooth opengl ptest multiarch pam systemd virtualization vulkan wifi"
FREEDOM_DEFAULT_EXTRA_RDEPENDS = "packagegroup-core-boot"
FREEDOM_DEFAULT_EXTRA_RRECOMMENDS = "kernel-module-af-packet"

DISTRO_FEATURES ?= "${DISTRO_FEATURES_DEFAULT} ${FREEDOM_DEFAULT_DISTRO_FEATURES}"

PREFERRED_PROVIDER_virtual/kernel ?= "linux-sifive-hf-premier-p550"

PREFERRED_PROVIDER_u-boot ?= "u-boot-sifive-hf-prem"
PREFERRED_PROVIDER_virtual/bootloader ?= "u-boot-sifive-hf-prem"

PREFERRED_PROVIDER_opensbi ?= "opensbi-sifive-hf-prem"

PREFERRED_PROVIDER_llvm = "clang"
PREFERRED_PROVIDER_llvm-native = "clang-native"
PREFERRED_PROVIDER_nativesdk-llvm = "nativesdk-clang"
PROVIDES:pn-clang = "llvm"
PROVIDES:pn-clang-native = "llvm-native"
PROVIDES:pn-nativesdk-clang = "nativesdk-llvm"

SDK_NAME = "${DISTRO}-${TCLIBC}-${SDKMACHINE}-${IMAGE_BASENAME}-${TUNE_PKGARCH}-${MACHINE}"
SDKPATHINSTALL = "/opt/${DISTRO}/${SDK_VERSION}"

DISTRO_EXTRA_RDEPENDS += "${FREEDOM_DEFAULT_EXTRA_RDEPENDS}"
DISTRO_EXTRA_RRECOMMENDS += "${FREEDOM_DEFAULT_EXTRA_RRECOMMENDS}"

TCLIBCAPPEND = ""

PACKAGE_CLASSES ?= "package_rpm"

SANITY_TESTED_DISTROS ?= " \
            ubuntu-20.04 \n \
            "

require conf/distro/include/no-static-libs.inc
require conf/distro/include/yocto-uninative.inc
require conf/distro/include/security_flags.inc
INHERIT += "uninative"

BB_SIGNATURE_HANDLER ?= "OEEquivHash"
BB_HASHSERVE ??= "auto"

FREEDOM_INIT_MANAGER = "systemd"
INIT_MANAGER ?= "${FREEDOM_INIT_MANAGER}"

# Enable creation of SPDX manifests by default
INHERIT += "create-spdx"

CLANGSDK = "1"

FORTRAN:forcevariable = ",fortran"

PREFERRED_PROVIDER_base-utils = "packagegroup-core-base-utils"
VIRTUAL-RUNTIME_base-utils = "packagegroup-core-base-utils"
VIRTUAL-RUNTIME_base-utils-hwclock = "util-linux-hwclock"
VIRTUAL-RUNTIME_base-utils-syslog = ""

VIRTUAL-RUNTIME_vim = "vim"

EXTRA_IMAGE_FEATURES:append = " package-management"

INHERIT += "extrausers"
EXTRA_USERS_PARAMS = "usermod -p '\$6\$PWVNV6MfuO4pMdqO\$54BibXcgV/nXMrgbaMBioGHNDv1uGVFarQN9QnqM8IMOI/nEwnpB5noxJozigw0lObahcmc3lqTMPvLoSpXnP1' root;"
```

## conf/distro/freedom-u-sdk.conf
```bitbake
DISTRO = "freedom-u-sdk"
DISTRO_NAME = "FreedomUSDK (SiFive Freedom Unleashed SDK)"
DISTRO_VERSION = "2024.10.00"
DISTRO_CODENAME = "2024November"
SDK_VENDOR = "-freedomusdk"
SDK_VERSION = "${@d.getVar('DISTRO_VERSION').replace('snapshot-${METADATA_REVISION}', 'snapshot')}"
SDK_VERSION[vardepvalue] = "${SDK_VERSION}"

MAINTAINER = " SiFive <null@sifive.com>"

TARGET_VENDOR = "-freedomusdk"

LOCALCONF_VERSION = "2"

# Override these in FreedomUSDK based distros
FREEDOM_DEFAULT_DISTRO_FEATURES = "bluetooth opengl ptest multiarch pam systemd virtualization vulkan wifi"
FREEDOM_DEFAULT_EXTRA_RDEPENDS = "packagegroup-core-boot"
FREEDOM_DEFAULT_EXTRA_RRECOMMENDS = "kernel-module-af-packet"

DISTRO_FEATURES ?= "${DISTRO_FEATURES_DEFAULT} ${FREEDOM_DEFAULT_DISTRO_FEATURES}"

PREFERRED_PROVIDER_virtual/kernel ?= "linux-sifive"

PREFERRED_PROVIDER_u-boot ?= "u-boot-sifive"
PREFERRED_PROVIDER_u-boot:qemuriscv64 = "u-boot-sifive"
PREFERRED_PROVIDER_virtual/bootloader ?= "u-boot-sifive"
PREFERRED_PROVIDER_virtual/bootloader:qemuriscv64 = "u-boot-sifive"

PREFERRED_PROVIDER_opensbi ?= "opensbi-sifive"

PREFERRED_PROVIDER_llvm = "clang"
PREFERRED_PROVIDER_llvm-native = "clang-native"
PREFERRED_PROVIDER_nativesdk-llvm = "nativesdk-clang"
PROVIDES:pn-clang = "llvm"
PROVIDES:pn-clang-native = "llvm-native"
PROVIDES:pn-nativesdk-clang = "nativesdk-llvm"

PREFERRED_VERSION_webkitgtk ?= "2.44.3"

SDK_NAME = "${DISTRO}-${TCLIBC}-${SDKMACHINE}-${IMAGE_BASENAME}-${TUNE_PKGARCH}-${MACHINE}"
SDKPATHINSTALL = "/opt/${DISTRO}/${SDK_VERSION}"

DISTRO_EXTRA_RDEPENDS += "${FREEDOM_DEFAULT_EXTRA_RDEPENDS}"
DISTRO_EXTRA_RRECOMMENDS += "${FREEDOM_DEFAULT_EXTRA_RRECOMMENDS}"

PACKAGE_CLASSES ?= "package_rpm"

SANITY_TESTED_DISTROS ?= " \
            poky-5.0 \n \
            poky-5.1 \n \
            ubuntu-20.04 \n \
            ubuntu-22.04 \n \
            ubuntu-24.04 \n \
            ubuntu-24.10 \n \
            fedora-38 \n \
            fedora-39 \n \
            fedora-40 \n \
            centosstream-8 \n \
            debian-11 \n \
            debian-12 \n \
            opensuseleap-15.4 \n \
            opensuseleap-15.5 \n \
            opensuseleap-15.6 \n \
            almalinux-8.8 \n \
            almalinux-9.2 \n \
            rocky-9 \n \
            "

require conf/distro/include/no-static-libs.inc
require conf/distro/include/yocto-uninative.inc
require conf/distro/include/security_flags.inc
require conf/distro/include/yocto-space-optimize.inc
INHERIT += "uninative"

BB_SIGNATURE_HANDLER ?= "OEEquivHash"
BB_HASHSERVE ??= "auto"

FREEDOM_INIT_MANAGER = "systemd"
INIT_MANAGER ?= "${FREEDOM_INIT_MANAGER}"

# Enable creation of SPDX manifests by default
INHERIT += "create-spdx"

CLANGSDK = "1"

FORTRAN:forcevariable = ",fortran"

PREFERRED_PROVIDER_base-utils = "packagegroup-core-base-utils"
VIRTUAL-RUNTIME_base-utils = "packagegroup-core-base-utils"
VIRTUAL-RUNTIME_base-utils-hwclock = "util-linux-hwclock"
VIRTUAL-RUNTIME_base-utils-syslog = ""

VIRTUAL-RUNTIME_vim = "vim"

EXTRA_IMAGE_FEATURES:append = " package-management"

QEMU_TARGETS = "riscv64"

INITRAMFS_IMAGE ?= "demo-coreip-cli-initramfs"
INITRAMFS_IMAGE:qemuall ?= ""
INITRAMFS_IMAGE_BUNDLE ?= "1"
INITRAMFS_FSTYPES ?= "cpio.gz"

IMAGE_BOOT_FILES:append = " ${KERNEL_IMAGETYPE}-initramfs-${MACHINE}.bin"

INHERIT += "extrausers"
EXTRA_USERS_PARAMS = "usermod -p '\$6\$PWVNV6MfuO4pMdqO\$54BibXcgV/nXMrgbaMBioGHNDv1uGVFarQN9QnqM8IMOI/nEwnpB5noxJozigw0lObahcmc3lqTMPvLoSpXnP1' root;"
```

## conf/layer.conf
```bitbake
# We have a conf and classes directory, add to BBPATH
BBPATH =. "${LAYERDIR}:"

# We have recipes-* directories, add to BBFILES
BBFILES += "${LAYERDIR}/recipes-*/*/*.bb \
            ${LAYERDIR}/recipes-*/*/*.bbappend"

BBFILE_COLLECTIONS += "freedom-u-sdk"
BBFILE_PATTERN_freedom-u-sdk = "^${LAYERDIR}/"
BBFILE_PRIORITY_freedom-u-sdk = "9"

LAYERSERIES_COMPAT_freedom-u-sdk = "nanbield"

# This should only be incremented on significant changes that will
# cause compatibility issues with other layers
LAYERVERSION_freedom-u-sdk = "2"

LAYERDEPENDS_freedom-u-sdk = "\
    clang-layer \
    core \
    filesystems-layer \
    gnome-layer \
    meta-python \
    meta-sifive \
    meta-tensorflow-lite \
    multimedia-layer \
    networking-layer \
    openembedded-layer \
    virtualization-layer \
    xfce-layer \
"
```

## conf/linux_defconfig
```kconfig
CONFIG_SMP=y
CONFIG_PCI=y
CONFIG_PCI_DEBUG=y
CONFIG_PCI_ALMOND_FPGA=y
CONFIG_PCI_ENDPOINT=y
CONFIG_PCI_ENDPOINT_CONFIGFS=y
CONFIG_PCI_EPF_TEST=y
CONFIG_CROSS_COMPILE="riscv64-unknown-linux-gnu-"
CONFIG_SYSVIPC=y
CONFIG_POSIX_MQUEUE=y
CONFIG_CGROUPS=y
CONFIG_CGROUP_SCHED=y
CONFIG_CFS_BANDWIDTH=y
CONFIG_CGROUP_BPF=y
CONFIG_NAMESPACES=y
CONFIG_USER_NS=y
CONFIG_BLK_DEV_INITRD=y
CONFIG_INITRAMFS_SOURCE="/scratch/paulw/freedom-u-sdk/conf/initramfs.txt /scratch/paulw/freedom-u-sdk/work/buildroot_initramfs_sysroot"
CONFIG_INITRAMFS_ROOT_UID=1187
CONFIG_INITRAMFS_ROOT_GID=1187
CONFIG_EXPERT=y
CONFIG_CHECKPOINT_RESTORE=y
CONFIG_BPF_SYSCALL=y
# CONFIG_VM_EVENT_COUNTERS is not set
# CONFIG_SLUB_DEBUG is not set
# CONFIG_IOSCHED_DEADLINE is not set
# CONFIG_MQ_IOSCHED_DEADLINE is not set
# CONFIG_MQ_IOSCHED_KYBER is not set
CONFIG_NET=y
CONFIG_PACKET=y
CONFIG_UNIX=y
CONFIG_INET=y
CONFIG_IP_MULTICAST=y
CONFIG_IP_ADVANCED_ROUTER=y
CONFIG_IP_PNP=y
CONFIG_IP_PNP_DHCP=y
CONFIG_IP_PNP_BOOTP=y
CONFIG_IP_PNP_RARP=y
# CONFIG_IPV6 is not set
CONFIG_DNS_RESOLVER=y
CONFIG_NETLINK_DIAG=y
CONFIG_DEVTMPFS=y
CONFIG_BLK_DEV_LOOP=y
CONFIG_VIRTIO_BLK=y
CONFIG_BLK_DEV_NVME=y
CONFIG_BLK_DEV_SD=y
# CONFIG_SCSI_LOWLEVEL is not set
CONFIG_ATA=y
CONFIG_SATA_AHCI=y
CONFIG_SATA_AHCI_PLATFORM=y
CONFIG_NETDEVICES=y
CONFIG_VIRTIO_NET=y
CONFIG_MACB=y
CONFIG_E100=y
CONFIG_E1000=y
CONFIG_E1000E=y
CONFIG_IGB=y
CONFIG_IGBVF=y
CONFIG_IXGB=y
CONFIG_IXGBE=y
CONFIG_IXGBEVF=y
CONFIG_I40E=y
CONFIG_I40EVF=y
CONFIG_FM10K=y
CONFIG_R8169=y
CONFIG_MICROSEMI_PHY=y
CONFIG_INPUT_MOUSEDEV=y
# CONFIG_INPUT_KEYBOARD is not set
# CONFIG_INPUT_MOUSE is not set
CONFIG_SERIAL_8250=y
CONFIG_SERIAL_8250_CONSOLE=y
CONFIG_SERIAL_OF_PLATFORM=y
CONFIG_SERIAL_SIFIVE=y
CONFIG_SERIAL_SIFIVE_CONSOLE=y
CONFIG_I2C_OCORES=y
CONFIG_SPI=y
CONFIG_SPI_SIFIVE=y
# CONFIG_PTP_1588_CLOCK is not set
CONFIG_GPIOLIB=y
CONFIG_GPIO_SIFIVE=y
CONFIG_DRM=y
# CONFIG_DRM_I2C_CH7006 is not set
# CONFIG_DRM_I2C_SIL164 is not set
CONFIG_DRM_RADEON=y
CONFIG_DRM_RADEON_USERPTR=y
CONFIG_DRM_AMDGPU=y
CONFIG_DRM_AMDGPU_USERPTR=y
CONFIG_DRM_NOUVEAU=y
CONFIG_FB_RADEON=y
CONFIG_FRAMEBUFFER_CONSOLE=y
CONFIG_LOGO=y
# CONFIG_LOGO_LINUX_MONO is not set
# CONFIG_LOGO_LINUX_VGA16 is not set
CONFIG_SOUND=y
CONFIG_SND=y
# CONFIG_SND_DRIVERS is not set
CONFIG_SND_OXYGEN=y
# CONFIG_SND_SPI is not set
# CONFIG_SND_USB is not set
CONFIG_USB=y
CONFIG_USB_XHCI_HCD=y
CONFIG_USB_XHCI_PLATFORM=y
CONFIG_USB_EHCI_HCD=y
CONFIG_USB_EHCI_HCD_PLATFORM=y
CONFIG_USB_OHCI_HCD=y
CONFIG_USB_OHCI_HCD_PLATFORM=y
CONFIG_USB_STORAGE=y
CONFIG_USB_UAS=y
CONFIG_MMC=y
CONFIG_MMC_SPI=y
CONFIG_VIRTIO_MMIO=y
# CONFIG_IOMMU_SUPPORT is not set
CONFIG_EXT4_FS=y
CONFIG_EXT4_FS_POSIX_ACL=y
CONFIG_MSDOS_FS=y
CONFIG_VFAT_FS=y
CONFIG_TMPFS=y
CONFIG_TMPFS_POSIX_ACL=y
# CONFIG_MISC_FILESYSTEMS is not set
# CONFIG_NETWORK_FILESYSTEMS is not set
CONFIG_CMDLINE_BOOL=y
CONFIG_CMDLINE="earlyprintk console=tty0 console=ttySI0,115200 video=640x480 ignore_loglevel debug init=/bin/ash pci=nomsi"
CONFIG_CMDLINE_OVERRIDE=y
CONFIG_MAGIC_SYSRQ=y
# CONFIG_RCU_TRACE is not set
# CONFIG_FTRACE is not set
CONFIG_CRYPTO_USER_API_HASH=y
# CONFIG_XZ_DEC_X86 is not set
# CONFIG_XZ_DEC_POWERPC is not set
# CONFIG_XZ_DEC_IA64 is not set
# CONFIG_XZ_DEC_ARM is not set
# CONFIG_XZ_DEC_ARMTHUMB is not set
# CONFIG_XZ_DEC_SPARC is not set
```

## conf/linux_u500vc707devkit_defconfig
```kconfig
CONFIG_SMP=y
# CONFIG_COMPACTION is not set
CONFIG_HZ_100=y
CONFIG_PCI=y
CONFIG_PCI_DEBUG=y
CONFIG_PCIE_XILINX=y
CONFIG_CROSS_COMPILE="riscv64-unknown-linux-gnu-"
CONFIG_DEFAULT_HOSTNAME="ucbvax"
# CONFIG_CROSS_MEMORY_ATTACH is not set
CONFIG_NAMESPACES=y
CONFIG_BLK_DEV_INITRD=y
# CONFIG_RD_BZIP2 is not set
# CONFIG_RD_LZMA is not set
# CONFIG_RD_XZ is not set
# CONFIG_RD_LZO is not set
# CONFIG_RD_LZ4 is not set
CONFIG_EMBEDDED=y
# CONFIG_BLK_DEV_BSG is not set
CONFIG_PARTITION_ADVANCED=y
# CONFIG_IOSCHED_DEADLINE is not set
CONFIG_NET=y
CONFIG_PACKET=y
CONFIG_UNIX=y
CONFIG_INET=y
# CONFIG_INET_XFRM_MODE_TRANSPORT is not set
# CONFIG_INET_XFRM_MODE_TUNNEL is not set
# CONFIG_INET_XFRM_MODE_BEET is not set
# CONFIG_INET_DIAG is not set
# CONFIG_IPV6 is not set
CONFIG_DEVTMPFS=y
CONFIG_DEVTMPFS_MOUNT=y
# CONFIG_FIRMWARE_IN_KERNEL is not set
CONFIG_VIRTIO_BLK=y
CONFIG_BLK_DEV_SD=y
CONFIG_ATA=y
CONFIG_SATA_AHCI=y
CONFIG_SATA_SIL24=y
CONFIG_NETDEVICES=y
CONFIG_VIRTIO_NET=y
CONFIG_E1000E=y
CONFIG_R8169=y
# CONFIG_INPUT_KEYBOARD is not set
# CONFIG_INPUT_MOUSE is not set
# CONFIG_VT is not set
CONFIG_SERIAL_8250=y
CONFIG_SERIAL_8250_CONSOLE=y
# CONFIG_SERIAL_8250_PCI is not set
CONFIG_SERIAL_OF_PLATFORM=y
CONFIG_VIRTIO_CONSOLE=y
# CONFIG_HW_RANDOM is not set
# CONFIG_HWMON is not set
CONFIG_USB=y
CONFIG_USB_XHCI_HCD=y
CONFIG_USB_EHCI_HCD=y
CONFIG_USB_STORAGE=y
CONFIG_VIRTIO_MMIO=y
# CONFIG_IOMMU_SUPPORT is not set
CONFIG_EXT3_FS=y
# CONFIG_PROC_PAGE_MONITOR is not set
CONFIG_TMPFS=y
# CONFIG_MISC_FILESYSTEMS is not set
# CONFIG_NETWORK_FILESYSTEMS is not set
CONFIG_CMDLINE_BOOL=y
CONFIG_CMDLINE="earlyprintk"
CONFIG_PRINTK_TIME=y
CONFIG_STRIP_ASM_SYMS=y
CONFIG_DEBUG_SECTION_MISMATCH=y
CONFIG_STACKTRACE=y
# CONFIG_CRYPTO_HW is not set
```

## meta-sifive/conf/layer.conf
```bitbake
# We have a conf and classes directory, add to BBPATH
BBPATH .= ":${LAYERDIR}"

# We have recipes-* directories, add to BBFILES
BBFILES += "${LAYERDIR}/recipes-*/*/*.bb \
            ${LAYERDIR}/recipes-*/*/*.bbappend"

BBFILE_COLLECTIONS += "meta-sifive"
BBFILE_PATTERN_meta-sifive = "^${LAYERDIR}/"
BBFILE_PRIORITY_meta-sifive = "8"

# This should only be incremented on significant changes that will
# cause compatibility issues with other layers
LAYERVERSION_meta-sifive-layer = "1"

# This layer needs a bunch of other layers
LAYERDEPENDS_meta-sifive  = "core"
LAYERDEPENDS_meta-sifive += "riscv-layer"
LAYERDEPENDS_meta-sifive += "openembedded-layer"
LAYERDEPENDS_meta-sifive += "networking-layer"

# FIXME: I don't know what "warrior" is, but I need this line
LAYERSERIES_COMPAT_meta-sifive = "warrior"
```

## meta-sifive/conf/machine/qemuriscv64.conf
```bitbake
#@TYPE: Machine
#@NAME: generic riscv64 machine
#@DESCRIPTION: QEMU's 64-bit RISC-V virt platform

require conf/machine/qemuriscv64.conf
```
